#include "break.h"
#include "delay.h"
#include "string.h"
#include "uart.h"
#include "rs485.h"

// CRC 高位字节值表
static const unsigned char s_CRCHi[] = {
    0x00, 0xC1, 0x81, 0x40, 0x01, 0xC0, 0x80, 0x41, 0x01, 0xC0,
    0x80, 0x41, 0x00, 0xC1, 0x81, 0x40, 0x01, 0xC0, 0x80, 0x41,
    0x00, 0xC1, 0x81, 0x40, 0x00, 0xC1, 0x81, 0x40, 0x01, 0xC0,
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    0x80, 0x41, 0x00, 0xC1, 0x81, 0x40
} ;
// CRC 低位字节值表
const unsigned char s_CRCLo[] = {
	0x00, 0xC0, 0xC1, 0x01, 0xC3, 0x03, 0x02, 0xC2, 0xC6, 0x06,
	0x07, 0xC7, 0x05, 0xC5, 0xC4, 0x04, 0xCC, 0x0C, 0x0D, 0xCD,
	0x0F, 0xCF, 0xCE, 0x0E, 0x0A, 0xCA, 0xCB, 0x0B, 0xC9, 0x09,
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	0x43, 0x83, 0x41, 0x81, 0x80, 0x40
};

const char buf[8]={0x01,0x03,0x00,0x08,0x00,0x02,0x45,0xc9};		//控制通断指令

/*01 05 00 00 00 00 CD CA		关闸
  01 05 00 00 FF 00 8C 3A		合闸		
	先关闸再合闸，注意波特率较低 指令间时间*/		
const char offbuf[8]={0x01,0x05,0x00,0x00,0x00,0x00,0xCD,0xCA};
const char onbuf[8]={0x01,0x05,0x00,0x00,0xFF,0x00,0x8C,0x3A};
const char buf1[2]={0x01,0x02};
void Control_init(void)
{
	rs485_init(1200);		//485控制串口初始化
	TIME6_Init(99,7199);//定时10ms
}

void Restart_break(void)
{
	MODH_Send03H(0x01,0x0000,0x0000);				//填入modbus寄存器的值		关
	delay_ms(100);
	if(rs485_recv_flag==1)
	{
		CLR_485_Buf();
		rs485_recv_flag=0;
	}
	delay_ms(100);
	MODH_Send03H(0x01,0x0000,0x0000);				//填入modbus寄存器的值		关
	delay_ms(100);
	if(rs485_recv_flag==1)
	{
		CLR_485_Buf();
		rs485_recv_flag=0;
	}
	
	delay_ms(500);
	
	MODH_Send03H(0x01,0x0000,0xff00);				//填入modbus寄存器的值		开
	delay_ms(100);
	if(rs485_recv_flag==1)
	{
		CLR_485_Buf();
		rs485_recv_flag=0;
	}
	delay_ms(100);
	MODH_Send03H(0x01,0x0000,0xff00);				//填入modbus寄存器的值		开
	delay_ms(100);
	if(rs485_recv_flag==1)
	{
		CLR_485_Buf();
		rs485_recv_flag=0;
	}
}

/************************************************************************************
* 函数名称：CLR_GSM_Buf
* 功能描述：清除GSM串口缓存
* 入口参数：无
* 出口参数：无
*************************************************************************************/
void CLR_485_Buf(void)
{
	u16 k;
	for(k=0;k<64;k++)      //将缓存内容清零
	{
		RS485_RX_BUF[k] = 0x00;
	}
  RS485_RX_CNT = 0;              //接收字符串的起始存储位置
}


/************************************************************************************
* 函数名称：CRC16_Modbus
* 功能描述：自动CRC16校验
* 入口参数：_pBuf：参与校验数据
						_usLen：数据长度
* 出口参数：16位校验值
*************************************************************************************/
u16 CRC16_Modbus(u8 *_pBuf, int _usLen)
{
  char ucCRCHi = 0xFF; /* 高CRC字节初始化 */
	char ucCRCLo = 0xFF; /* 低CRC 字节初始化 */
	int usIndex;  /* CRC循环中的索引 */

  while (_usLen--)
  {
		usIndex = ucCRCHi ^ *_pBuf++; /* 计算CRC */
		ucCRCHi = ucCRCLo ^ s_CRCHi[usIndex];
		ucCRCLo = s_CRCLo[usIndex];
  }
    return ((u16)ucCRCHi << 8 | ucCRCLo);
}


/************************************************************************************
* 函数名称：MODH_SendAckWithCRC
* 功能描述：发送应答，自动加CRC
* 入口参数：无
* 出口参数：无
*************************************************************************************/
static void MODH_SendAckWithCRC(void)
{
	u16 crc;
	crc = CRC16_Modbus(RS485_TX_BUF, RS485_TX_CNT);
	RS485_TX_BUF[RS485_TX_CNT++] = crc >> 8;
	RS485_TX_BUF[RS485_TX_CNT++] = crc;	
	//UART5_Send_Data(RS485_TX_BUF,RS485_TX_CNT);
	RS485_Send_Data(RS485_TX_BUF, RS485_TX_CNT);
}


/************************************************************************************
* 函数名称：MODH_Send03H
* 功能描述：发送03系列指令，自动加CRC
* 入口参数：_addr：丛机地址 
						_reg：寄存器编号
						_num：寄存器个数
* 出口参数：无
*************************************************************************************/
void MODH_Send03H(u8 _addr, u16 _reg, u16 _num)
{
	RS485_TX_CNT = 0;
	RS485_TX_BUF[RS485_TX_CNT++] = _addr;		//从站地址
	RS485_TX_BUF[RS485_TX_CNT++] = 0x05;		//功能码	
	RS485_TX_BUF[RS485_TX_CNT++] = _reg >> 8;	//寄存器编号 高字节
	RS485_TX_BUF[RS485_TX_CNT++] = _reg;		//寄存器编号 低字节
	RS485_TX_BUF[RS485_TX_CNT++] = _num >> 8;	//寄存器个数 高字节 
	RS485_TX_BUF[RS485_TX_CNT++] = _num;		//寄存器个数 低字节 
	
	MODH_SendAckWithCRC();		//发送数据，自动加CRC
}


